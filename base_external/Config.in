## base_external/Config.in
```kconfig
source "$BR2_EXTERNAL_project_base_PATH/package/gpio_package/Config.in"
source "$BR2_EXTERNAL_project_base_PATH/package/socket-test_package/Config.in"
source "$BR2_EXTERNAL_project_base_PATH/package/lcd_package/Config.in"
source "$BR2_EXTERNAL_project_base_PATH/package/lcd16x2_package/Config.in"
source "$BR2_EXTERNAL_project_base_PATH/package/client_package/Config.in"
```

## base_external/package/gpio_package/Config.in
```kconfig
config BR2_PACKAGE_GPIO_PACKAGE
	bool "gpio_package"
	help
	  Includes the code for gpio write, gpio read, executables and files in the kernel image.
	  Used to understand buildroot external trees and package builds.
```

## base_external/package/lcd16x2_package/Config.in
```kconfig
config BR2_PACKAGE_LCD16X2_PACKAGE
	bool "lcd16x2_package"
	help
	  Includes the code for nokia 5110 lcd executables and files in the kernel image.
	  Used to understand buildroot external trees and package builds.
```

## base_external/package/lcd_package/Config.in
```kconfig
config BR2_PACKAGE_LCD_PACKAGE
	bool "lcd_package"
	help
	  Includes the code for nokia 5110 lcd executables and files in the kernel image.
	  Used to understand buildroot external trees and package builds.
```

## base_external/package/led_package/Config.in
```kconfig
config BR2_PACKAGE_LED_PACKAGE
	bool "led_package"
	help
	  Includes the test code for libgpiod led executables and files in the kernel image.
	  Used to understand buildroot external trees and package builds.
```

## base_external/package/socket-test_package/Config.in
```kconfig
config BR2_PACKAGE_SOCKET_TEST_PACKAGE
	bool "socket_test_package"
	help
	  Includes the code for simple socket test in the kernel image.
	  Used to understand buildroot external trees and package builds.
```
